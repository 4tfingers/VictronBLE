## CMakeLists.txt
```
# SPDX-License-Identifier: MIT
cmake_minimum_required(VERSION 3.20.0)

find_package(Zephyr REQUIRED HINTS $ENV{ZEPHYR_BASE})
project(victronble_scan)

target_sources(app PRIVATE src/main.c)
```

## sample.yaml
```
sample:
  name: VictronBLE scan
  description: List every Victron device advertising nearby, no keys required
tests:
  sample.victronble.scan:
    build_only: true
    platform_allow:
      - nrf52840dk/nrf52840
      - rak4631/nrf52840
    tags: bluetooth victron
```

## prj.conf
```kconfig
# Bluetooth: observer role only — no connections, no pairing, no advertising.
CONFIG_BT=y
CONFIG_BT_OBSERVER=y
CONFIG_BT_DEVICE_NAME="victron-scan"

# Discovery hears every Victron in range, so the advertising-report pool and
# the library's decode queue both see more traffic than in normal operation.
CONFIG_BT_BUF_EVT_DISCARDABLE_COUNT=20

CONFIG_VICTRONBLE=y

# Watch mode queues every Victron advert, not just the registered ones.
CONFIG_VICTRONBLE_QUEUE_DEPTH=16

# No devices are registered — this sample never decrypts anything.
CONFIG_VICTRONBLE_MAX_DEVICES=1

# Discovery wants to find things quickly, so trade power for a much higher
# duty cycle than the library's defaults: 60 ms interval / 30 ms window
# (BT_GAP_SCAN_FAST_*) instead of 1.28 s / 11.25 ms.
CONFIG_VICTRONBLE_SCAN_INTERVAL=96
CONFIG_VICTRONBLE_SCAN_WINDOW=48

CONFIG_LOG=y
CONFIG_VICTRONBLE_LOG_LEVEL_INF=y
```

## src/main.c
```c
/**
 * VictronBLE Zephyr discovery sample.
 *
 * Turns on the library's watch mode and does nothing else. No advertisement
 * keys, no device list: every Victron Instant Readout advert in range is
 * logged with its address, RSSI, device type and key-check byte.
 *
 * Run this first to find out what you have and what its MAC address is, then
 * put the addresses and keys into samples/observer.
 *
 * Copyright (c) 2026 Scott Penrose
 * License: MIT
 */

#include <zephyr/kernel.h>
#include <zephyr/bluetooth/bluetooth.h>
#include <zephyr/logging/log.h>

#include "victronble_zephyr.h"

LOG_MODULE_REGISTER(scan, LOG_LEVEL_INF);

#define STATS_INTERVAL K_SECONDS(30)

int main(void)
{
	struct victronble_stats stats;
	int err;

	LOG_INF("VictronBLE discovery — logging every Victron advert in range");

	/* The application owns the Bluetooth stack: victronble_start() needs
	 * it up already. */
	err = bt_enable(NULL);
	if (err != 0) {
		LOG_ERR("bt_enable failed (%d)", err);
		return 0;
	}

	/* All output comes from the library's own log module (victronble).
	 * Unregistered devices are not nonce-deduplicated, so expect roughly
	 * one line per device per second. */
	victronble_watch_set(true);

	err = victronble_start();
	if (err != 0) {
		LOG_ERR("victronble_start failed (%d)", err);
		return 0;
	}

	while (1) {
		k_sleep(STATS_INTERVAL);

		victronble_get_stats(&stats);
		LOG_INF("stats: adverts %u queued %u dropped %u", stats.adverts,
			stats.queued, stats.dropped);

		if (stats.adverts == 0) {
			LOG_WRN("nothing heard yet — check the device has "
				"'Instant readout via Bluetooth' enabled in "
				"VictronConnect");
		}
	}

	return 0;
}
```
